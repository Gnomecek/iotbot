## main/Kconfig.projbuild
```kconfig
menu "Discord Bot"

    config DISCORD_CHANNEL_ID
        string "Bot Channel Id"
        help
            Default channel Id bot sends messages to 

endmenu
```

## sdkconfig.defaults
```kconfig
CONFIG_ESPTOOLPY_FLASHSIZE_4MB=y
CONFIG_ESPTOOLPY_FLASHSIZE="4MB"

CONFIG_PARTITION_TABLE_SINGLE_APP_LARGE=y
```
